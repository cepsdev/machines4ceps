VERSION ""

NS_ :

BS_:

BO_ 601 myframe: 1 channel1
 SG_ a_signal : 0|8@1+ (1,0) [-100|100] ""  channel1

VAL_ 601 a_signal 0 "a" 1 "b" 2 "c" ;
