VERSION ""

NS_ :

BS_:

BU_: CFBP

BO_ 657 CFBP_DigIn_TxPDO_06: 8 CFBP
 SG_ CFBP_DigIn063 : 62|2@1+ (1,0) [0|0] "" Vector__XXX
 SG_ CFBP_DigIn062 : 60|2@1+ (1,0) [0|0] "" Vector__XXX
 SG_ CFBP_DigIn061 : 58|2@1+ (1,0) [0|0] "" Vector__XXX
 SG_ CFBP_DigIn060 : 56|2@1+ (1,0) [0|0] "" Vector__XXX
 SG_ CFBP_DigIn059 : 54|2@1+ (1,0) [0|0] "" Vector__XXX
 SG_ CFBP_DigIn058 : 52|2@1+ (1,0) [0|0] "" Vector__XXX
 SG_ CFBP_DigIn057 : 50|2@1+ (1,0) [0|0] "" Vector__XXX
 SG_ CFBP_DigIn056 : 48|2@1+ (1,0) [0|0] "" Vector__XXX
 SG_ CFBP_DigIn055 : 46|2@1+ (1,0) [0|0] "" Vector__XXX
 SG_ CFBP_DigIn054 : 44|2@1+ (1,0) [0|0] "" Vector__XXX
 SG_ CFBP_DigIn053 : 42|2@1+ (1,0) [0|0] "" Vector__XXX
 SG_ CFBP_DigIn052 : 40|2@1+ (1,0) [0|0] "" Vector__XXX
 SG_ CFBP_DigIn051 : 38|2@1+ (1,0) [0|0] "" Vector__XXX
 SG_ CFBP_DigIn050 : 36|2@1+ (1,0) [0|0] "" Vector__XXX
 SG_ CFBP_DigIn049 : 34|2@1+ (1,0) [0|0] "" Vector__XXX
 SG_ CFBP_DigIn048 : 32|2@1+ (1,0) [0|0] "" Vector__XXX
 SG_ CFBP_DigIn047 : 30|2@1+ (1,0) [0|0] "" Vector__XXX
 SG_ CFBP_DigIn046 : 28|2@1+ (1,0) [0|0] "" Vector__XXX
 SG_ CFBP_DigIn045 : 26|2@1+ (1,0) [0|0] "" Vector__XXX
 SG_ CFBP_DigIn044 : 24|2@1+ (1,0) [0|0] "" Vector__XXX
 SG_ CFBP_DigIn043 : 22|2@1+ (1,0) [0|0] "" Vector__XXX
 SG_ CFBP_DigIn042 : 20|2@1+ (1,0) [0|0] "" Vector__XXX
 SG_ CFBP_DigIn041 : 18|2@1+ (1,0) [0|0] "" Vector__XXX
 SG_ CFBP_DigIn040 : 16|2@1+ (1,0) [0|0] "" Vector__XXX
 SG_ CFBP_DigIn039 : 14|2@1+ (1,0) [0|0] "" Vector__XXX
 SG_ CFBP_DigIn038 : 12|2@1+ (1,0) [0|0] "" Vector__XXX
 SG_ CFBP_DigIn037 : 10|2@1+ (1,0) [0|0] "" Vector__XXX
 SG_ CFBP_DigIn036 : 8|2@1+ (1,0) [0|0] "" Vector__XXX
 SG_ CFBP_DigIn035 : 6|2@1+ (1,0) [0|0] "" Vector__XXX
 SG_ CFBP_DigIn034 : 4|2@1+ (1,0) [0|0] "" Vector__XXX
 SG_ CFBP_DigIn033 : 2|2@1+ (1,0) [0|0] "" Vector__XXX
 SG_ CFBP_DigIn032 : 0|2@1+ (1,0) [0|0] "" Vector__XXX

CM_ SG_ 657 CFBP_DigIn060 "NEBELSCHEINWERFER_AN";
CM_ SG_ 657 CFBP_DigIn059 "WARNBLINKSCHALTER_NO";
CM_ SG_ 657 CFBP_DigIn057 "INNENBEL_KDT_NO";
CM_ SG_ 657 CFBP_DigIn056 "TASTER_NEBELSCHLUSSLEUCHTE_EIN";
CM_ SG_ 657 CFBP_DigIn055 "LENKSTOCK_BLINKER_RECHTS";
CM_ SG_ 657 CFBP_DigIn054 "LENKSTOCK_BLINKER_LINKS";
CM_ SG_ 657 CFBP_DigIn053 "LENKSTOCK_FERNLICHT_ABBLEND_UM_56";
CM_ SG_ 657 CFBP_DigIn052 "LENKSTOCK_ABBLENDLICHT_56B";
CM_ SG_ 657 CFBP_DigIn051 "LENKSTOCK_FERNLICHT_LICHTHUPE_56A";
CM_ SG_ 657 CFBP_DigIn050 "LENKSTOCK_HUPE_14";
CM_ SG_ 657 CFBP_DigIn049 "BREMSDRUCKMANGEL_IN";
CM_ SG_ 657 CFBP_DigIn048 "KLEMME_58";
CM_ SG_ 657 CFBP_DigIn047 "NBC_INNENDRUCK_ZU_GERING_ANZEIGE";
CM_ SG_ 657 CFBP_DigIn046 "NBC_ABC_VENTIL_OFFEN_ANZEIGE";
CM_ SG_ 657 CFBP_DigIn045 "NBC_NOTBETRIEB_ANZEIGE";
CM_ SG_ 657 CFBP_DigIn044 "NBC_LUEFTERFEHLER_ANZEIGE";
CM_ SG_ 657 CFBP_DigIn043 "NBC_HAUPTFILTER_VERSTOPFT_ANZEIGE";
CM_ SG_ 657 CFBP_DigIn042 "NBC_VORFILTER_VERSTOPFT_ANZEIGE";
CM_ SG_ 657 CFBP_DigIn041 "NBC_MODE_ANZEIGE";
CM_ SG_ 657 CFBP_DigIn040 "ZENTRALWARNUNG";
CM_ SG_ 657 CFBP_DigIn039 "RUNDUMKENNLEUCHTE_NO";
CM_ SG_ 657 CFBP_DigIn038 "FSB_FEHLER_IN";
CM_ SG_ 657 CFBP_DigIn037 "FSB_EINGELEGT_ANZEIGE";
CM_ SG_ 657 CFBP_DigIn036 "NETZE_VERBUNDEN_ANZEIGE";
CM_ SG_ 657 CFBP_DigIn035 "KONTROLLE_BLINKER_C_L";
CM_ SG_ 657 CFBP_DigIn034 "KONTROLLE_BLINKER_C_R";
CM_ SG_ 657 CFBP_DigIn033 "RM_FERNLICHT_EIN";
CM_ SG_ 657 CFBP_DigIn032 "WARNBLINKSCHALTER_GEM";
BA_DEF_ SG_  "GenSigSendType" ENUM  "Cyclic","OnWrite","OnWriteWithRepetition","OnChange","OnChangeWithRepetition","IfActive","IfActiveWithRepetition","NoSigSendType";
BA_DEF_ BO_  "GenMsgSendType" ENUM  "Cyclic","not_used","not_used","not_used","not_used","Cyclic","not_used","IfActive","NoMsgSendType";
BA_DEF_ BU_  "NmStationAddress" HEX 0 0;
BA_DEF_  "BusType" STRING ;
BA_DEF_  "DBName" STRING ;
BA_DEF_DEF_  "GenSigSendType" "Cyclic";
BA_DEF_DEF_  "GenMsgSendType" "NoMsgSendType";
BA_DEF_DEF_  "NmStationAddress" 0;
BA_DEF_DEF_  "BusType" "CAN";
BA_DEF_DEF_  "DBName" "";
BA_ "DBName" "CANopen";
BA_ "NmStationAddress" BU_ CFBP 16;
VAL_ 657 CFBP_DigIn063 3 "High, Status High" 2 "Low, Status High" 1 "High" 0 "Low" ;
VAL_ 657 CFBP_DigIn062 3 "High, Status High" 2 "Low, Status High" 1 "High" 0 "Low" ;
VAL_ 657 CFBP_DigIn061 3 "High, Status High" 2 "Low, Status High" 1 "High" 0 "Low" ;
VAL_ 657 CFBP_DigIn060 3 "High, Status High" 2 "Low, Status High" 1 "High" 0 "Low" ;
VAL_ 657 CFBP_DigIn059 3 "High, Status High" 2 "Low, Status High" 1 "High" 0 "Low" ;
VAL_ 657 CFBP_DigIn058 3 "High, Status High" 2 "Low, Status High" 1 "High" 0 "Low" ;
VAL_ 657 CFBP_DigIn057 3 "High, Status High" 2 "Low, Status High" 1 "High" 0 "Low" ;
VAL_ 657 CFBP_DigIn056 3 "High, Status High" 2 "Low, Status High" 1 "High" 0 "Low" ;
VAL_ 657 CFBP_DigIn055 3 "High, Status High" 2 "Low, Status High" 1 "High" 0 "Low" ;
VAL_ 657 CFBP_DigIn054 3 "High, Status High" 2 "Low, Status High" 1 "High" 0 "Low" ;
VAL_ 657 CFBP_DigIn053 3 "High, Status High" 2 "Low, Status High" 1 "High" 0 "Low" ;
VAL_ 657 CFBP_DigIn052 3 "High, Status High" 2 "Low, Status High" 1 "High" 0 "Low" ;
VAL_ 657 CFBP_DigIn051 3 "High, Status High" 2 "Low, Status High" 1 "High" 0 "Low" ;
VAL_ 657 CFBP_DigIn050 3 "High, Status High" 2 "Low, Status High" 1 "High" 0 "Low" ;
VAL_ 657 CFBP_DigIn049 3 "High, Status High" 2 "Low, Status High" 1 "High" 0 "Low" ;
VAL_ 657 CFBP_DigIn048 3 "High, Status High" 2 "Low, Status High" 1 "High" 0 "Low" ;
VAL_ 657 CFBP_DigIn047 3 "High, Status High" 2 "Low, Status High" 1 "High" 0 "Low" ;
VAL_ 657 CFBP_DigIn046 3 "High, Status High" 2 "Low, Status High" 1 "High" 0 "Low" ;
VAL_ 657 CFBP_DigIn045 3 "High, Status High" 2 "Low, Status High" 1 "High" 0 "Low" ;
VAL_ 657 CFBP_DigIn044 3 "High, Status High" 2 "Low, Status High" 1 "High" 0 "Low" ;
VAL_ 657 CFBP_DigIn043 3 "High, Status High" 2 "Low, Status High" 1 "High" 0 "Low" ;
VAL_ 657 CFBP_DigIn042 3 "High, Status High" 2 "Low, Status High" 1 "High" 0 "Low" ;
VAL_ 657 CFBP_DigIn041 3 "High, Status High" 2 "Low, Status High" 1 "High" 0 "Low" ;
VAL_ 657 CFBP_DigIn040 3 "High, Status High" 2 "Low, Status High" 1 "High" 0 "Low" ;
VAL_ 657 CFBP_DigIn039 3 "High, Status High" 2 "Low, Status High" 1 "High" 0 "Low" ;
VAL_ 657 CFBP_DigIn038 3 "High, Status High" 2 "Low, Status High" 1 "High" 0 "Low" ;
VAL_ 657 CFBP_DigIn037 3 "High, Status High" 2 "Low, Status High" 1 "High" 0 "Low" ;
VAL_ 657 CFBP_DigIn036 3 "High, Status High" 2 "Low, Status High" 1 "High" 0 "Low" ;
VAL_ 657 CFBP_DigIn035 3 "High, Status High" 2 "Low, Status High" 1 "High" 0 "Low" ;
VAL_ 657 CFBP_DigIn034 3 "High, Status High" 2 "Low, Status High" 1 "High" 0 "Low" ;
VAL_ 657 CFBP_DigIn033 3 "High, Status High" 2 "Low, Status High" 1 "High" 0 "Low" ;
VAL_ 657 CFBP_DigIn032 3 "High, Status High" 2 "Low, Status High" 1 "High" 0 "Low" ;
