VERSION ""

NS_ :

BS_:

BO_ 601 myframe: 1 channel1
 SG_ a_signal : 0|8@1+ (1,0) [-100|100] ""  channel1
BO_ 602 yourframe: 2 channel1
 SG_ b_signal : 0|8@1+ (1,0) [-100|100] ""  channel1
BO_ 603 yourframe2: 3 channel2
 SG_ c_signal : 0|8@1+ (1,0) [-100|100] ""  channel1

VAL_ 601 a_signal 0 "a" 1 "b" 2 "c" ;

BA_ "GenMsgCycleTime" BO_ 601 1000;
BA_ "GenMsgCycleTime" BO_ 602 2000;
BA_ "GenMsgCycleTime" BO_ 603 3000;
